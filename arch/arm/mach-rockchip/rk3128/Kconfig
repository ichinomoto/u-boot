## arch/arm/mach-rockchip/rk3128/Kconfig
```kconfig
if ROCKCHIP_RK3128

choice
	prompt "RK3128 board select"

config TARGET_EVB_RK3128
	bool "RK3128 evaluation board"
	select BOARD_LATE_INIT
	help
	  RK3128evb is a evaluation board for Rockchip rk3128,
	  with full function and phisical connectors support like
	  usb2.0 host ports, LVDS, JTAG, MAC, SDcard, HDMI, USB-2-serial...

config TARGET_POMERA_DM200
	bool "King Jim Pomera DM200"
	select BOARD_LATE_INIT
	help
	  Pomera DM200 with 512 MiB RAM, RK818 and UART1 console.
	  Runs after a Rockchip DDR loader and miniloader.

config TARGET_POMERA_DM250
	bool "King Jim Pomera DM250"
	select BOARD_LATE_INIT
	help
	  Pomera DM250 with 1 GiB RAM, RK818 and UART1 console.
	  Runs after a Rockchip DDR loader and miniloader.

config TARGET_POMERA_DM250US
	bool "King Jim Pomera DM250US"
	select BOARD_LATE_INIT
	help
	  Pomera DM250US with 1 GiB RAM, RK818 and UART1 console.
	  Runs after a Rockchip DDR loader and miniloader.

endchoice

config ROCKCHIP_BOOT_MODE_REG
	default 0x100a0038

config ROCKCHIP_STIMER_BASE
	default 0x200440a0

config SYS_SOC
	default "rk3128"

config SYS_MALLOC_F_LEN
	default 0x0800

source "board/rockchip/evb_rk3128/Kconfig"
source "board/kingjim/pomera_dm200/Kconfig"
source "board/kingjim/pomera_dm250/Kconfig"
source "board/kingjim/pomera_dm250us/Kconfig"

endif
```

## board/kingjim/pomera_dm200/Kconfig
```kconfig
if TARGET_POMERA_DM200

config SYS_BOARD
	default "pomera_dm200"

config SYS_VENDOR
	default "kingjim"

config SYS_CONFIG_NAME
	default "pomera_dm200"

endif
```

## board/kingjim/pomera_dm250/Kconfig
```kconfig
if TARGET_POMERA_DM250

config SYS_BOARD
	default "pomera_dm250"

config SYS_VENDOR
	default "kingjim"

config SYS_CONFIG_NAME
	default "pomera_dm250"

endif
```

## board/kingjim/pomera_dm250us/Kconfig
```kconfig
if TARGET_POMERA_DM250US

config SYS_BOARD
	default "pomera_dm250us"

config SYS_VENDOR
	default "kingjim"

config SYS_CONFIG_NAME
	default "pomera_dm250us"

endif
```

## configs/pomera-dm200_defconfig
```kconfig
CONFIG_ARM=y
CONFIG_SKIP_LOWLEVEL_INIT=y
CONFIG_ARCH_CPU_INIT=y
CONFIG_SYS_ARCH_TIMER=y
CONFIG_ARCH_ROCKCHIP=y
CONFIG_TEXT_BASE=0x60200000
CONFIG_NR_DRAM_BANKS=2
CONFIG_HAS_CUSTOM_SYS_INIT_SP_ADDR=y
CONFIG_CUSTOM_SYS_INIT_SP_ADDR=0x60100000
CONFIG_DEFAULT_DEVICE_TREE="rk3128-pomera-dm200"
CONFIG_ROCKCHIP_RK3128=y
CONFIG_TARGET_POMERA_DM200=y
CONFIG_SYS_BOOTM_LEN=0x4000000
CONFIG_SYS_LOAD_ADDR=0x60800800
CONFIG_DEBUG_UART_BASE=0x20064000
CONFIG_DEBUG_UART_CLOCK=24000000
CONFIG_DEBUG_UART=y
CONFIG_BOOTDELAY=3
CONFIG_USE_BOOTARGS=y
CONFIG_BOOTARGS="console=ttyS1,115200n8 console=tty1 root=/dev/mmcblk1p2 rootwait"
CONFIG_BOOTCOMMAND="dm200boot sd"
CONFIG_DEFAULT_FDT_FILE="rockchip/rk3128-pomera-dm200.dtb"
# CONFIG_DISPLAY_CPUINFO is not set
CONFIG_DISPLAY_BOARDINFO_LATE=y
CONFIG_CMD_GPIO=y
CONFIG_CMD_I2C=y
CONFIG_CMD_MMC=y
CONFIG_CMD_POWEROFF=y
# CONFIG_CMD_SETEXPR is not set
CONFIG_CMD_TIME=y
CONFIG_CMD_PMIC=y
CONFIG_CMD_REGULATOR=y
# CONFIG_OF_UPSTREAM is not set
CONFIG_SYSCON=y
CONFIG_BUTTON=y
CONFIG_BUTTON_GPIO=y
CONFIG_CLK=y
CONFIG_ROCKCHIP_GPIO=y
CONFIG_SYS_I2C_ROCKCHIP=y
CONFIG_MMC_DW=y
CONFIG_MMC_DW_ROCKCHIP=y
CONFIG_PINCTRL=y
CONFIG_DM_PMIC=y
CONFIG_PMIC_RK8XX=y
CONFIG_DM_REGULATOR_FIXED=y
CONFIG_REGULATOR_RK8XX=y
CONFIG_RAM=y
CONFIG_DEBUG_UART_SHIFT=2
CONFIG_SYS_NS16550_MEM32=y
CONFIG_SYSRESET=y
CONFIG_ERRNO_STR=y
```

## configs/pomera-dm250us_defconfig
```kconfig
CONFIG_ARM=y
CONFIG_SKIP_LOWLEVEL_INIT=y
CONFIG_ARCH_CPU_INIT=y
CONFIG_SYS_ARCH_TIMER=y
CONFIG_ARCH_ROCKCHIP=y
CONFIG_TEXT_BASE=0x60200000
CONFIG_SYS_MALLOC_F_LEN=0x10000
CONFIG_NR_DRAM_BANKS=2
CONFIG_HAS_CUSTOM_SYS_INIT_SP_ADDR=y
CONFIG_CUSTOM_SYS_INIT_SP_ADDR=0x60100000
CONFIG_DEFAULT_DEVICE_TREE="rk3128-pomera-dm250us"
CONFIG_DM_RESET=y
CONFIG_ROCKCHIP_RK3128=y
CONFIG_TARGET_POMERA_DM250US=y
CONFIG_SYS_BOOTM_LEN=0x4000000
CONFIG_SYS_LOAD_ADDR=0x60800800
CONFIG_DEBUG_UART_BASE=0x20064000
CONFIG_DEBUG_UART_CLOCK=24000000
CONFIG_DEBUG_UART=y
CONFIG_BOOTDELAY=1
CONFIG_USE_PREBOOT=y
CONFIG_PREBOOT="setenv stdin serial,tc3589x-keyb"
CONFIG_USE_BOOTARGS=y
CONFIG_BOOTARGS="console=ttyS1,115200n8 console=tty1 root=/dev/mmcblk1p2 rootwait quiet systemd.show_status=yes"
CONFIG_BOOTCOMMAND="sd"
CONFIG_DEFAULT_FDT_FILE="rockchip/rk3128-pomera-dm250us.dtb"
# CONFIG_DISPLAY_CPUINFO is not set
CONFIG_DISPLAY_BOARDINFO_LATE=y
CONFIG_CONSOLE_MUX=y
CONFIG_SYS_CONSOLE_IS_IN_ENV=y
CONFIG_CMD_GPIO=y
CONFIG_CMD_I2C=y
CONFIG_CMD_MMC=y
CONFIG_CMD_USB_MASS_STORAGE=y
CONFIG_CMD_UMS_ABORT_KEYED=y
CONFIG_CMD_POWEROFF=y
# CONFIG_CMD_SETEXPR is not set
CONFIG_CMD_TIME=y
CONFIG_CMD_PMIC=y
CONFIG_CMD_REGULATOR=y
# CONFIG_OF_UPSTREAM is not set
CONFIG_SYSCON=y
CONFIG_BUTTON=y
CONFIG_BUTTON_GPIO=y
CONFIG_DM_KEYBOARD=y
CONFIG_TC3589X_KEYB=y
CONFIG_CLK=y
CONFIG_ROCKCHIP_GPIO=y
CONFIG_SYS_I2C_ROCKCHIP=y
CONFIG_MMC_DW=y
CONFIG_MMC_DW_ROCKCHIP=y
CONFIG_PINCTRL=y
CONFIG_PHY_ROCKCHIP_INNO_DSIDPHY=y
CONFIG_PHY_ROCKCHIP_INNO_USB2=y
CONFIG_DM_PMIC=y
CONFIG_PMIC_RK8XX=y
CONFIG_DM_REGULATOR_FIXED=y
CONFIG_REGULATOR_RK8XX=y
CONFIG_DM_PWM=y
CONFIG_PWM_ROCKCHIP=y
CONFIG_RAM=y
CONFIG_DEBUG_UART_SHIFT=2
CONFIG_SYS_NS16550_MEM32=y
CONFIG_SYSRESET=y
CONFIG_ERRNO_STR=y
CONFIG_USB=y
# CONFIG_USB_FUNCTION_FASTBOOT is not set
CONFIG_DM_USB_GADGET=y
CONFIG_USB_GADGET=y
CONFIG_USB_GADGET_DOWNLOAD=y
CONFIG_USB_GADGET_DWC2_OTG=y
CONFIG_VIDEO=y
CONFIG_DISPLAY=y
CONFIG_VIDEO_ROCKCHIP=y
CONFIG_VIDEO_ROCKCHIP_MAX_XRES=1024
CONFIG_VIDEO_ROCKCHIP_MAX_YRES=600
CONFIG_DISPLAY_ROCKCHIP_LVDS=y
CONFIG_BACKLIGHT_PWM=y
CONFIG_PANEL=y
CONFIG_SIMPLE_PANEL=y
```
